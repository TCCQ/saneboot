## fit/virt.its
```
/*
 * Simple U-Boot uImage source file containing a single kernel. For use on qemu-virt.
 */

/dts-v1/;

/ {
        description = "Simple image with single Linux kernel and FDT blob";
        #address-cells = <1>;

        images {
                kernel {
                        description = "Simple FDT kernel";
                        data = /incbin/("../kernel/kernel");
                        type = "kernel";
                        arch = "riscv";
                        os = "linux";
                        compression = "none";
                        load = <0x80000000>;
                        entry = <0x80000000>;
                        hash-1 {
                                algo = "crc32";
                        };
                        hash-2 {
                                algo = "sha1";
                        };
                };
                fdt-1 {
                        description = "Flattened Device Tree blob";
                        data = /incbin/("./virt.dtb");
                        type = "flat_dt";
                        arch = "riscv";
                        compression = "none";
                        hash-1 {
                                algo = "crc32";
                        };
                        hash-2 {
                                algo = "sha1";
                        };
                };
        };

        configurations {
                default = "conf-1";
                conf-1 {
                        description = "Boot test kernel";
                        kernel = "kernel";
                        fdt = "fdt-1";
                };
        };
};
```

## fit/visionfive2.its
```
/*
 * Simple U-Boot uImage source file containing a single kernel and FDT blob
 */

/dts-v1/;

/ {
        description = "Simple image with single Linux kernel and FDT blob";
        #address-cells = <1>;

        images {
                kernel {
                        description = "Simple FDT kernel";
                        data = /incbin/("../kernel/kernel");
                        type = "kernel";
                        arch = "riscv";
                        os = "linux";
                        compression = "none";
                        load = <0x80000000>;
                        entry = <0x80000024>;
                        hash-1 {
                                algo = "crc32";
                        };
                        hash-2 {
                                algo = "sha1";
                        };
                };
                fdt-1 {
                        description = "Flattened Device Tree blob";
                        data = /incbin/("./visionfive2.dtb");
                        type = "flat_dt";
                        arch = "riscv";
                        compression = "none";
                        hash-1 {
                                algo = "crc32";
                        };
                        hash-2 {
                                algo = "sha1";
                        };
                };
        };

        configurations {
                default = "conf-1";
                conf-1 {
                        description = "Boot test kernel with FDT blob";
                        kernel = "kernel";
                        fdt = "fdt-1";
                };
        };
};
```
